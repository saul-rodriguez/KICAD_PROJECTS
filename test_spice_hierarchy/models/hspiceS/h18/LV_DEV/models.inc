* Path, Component, Release: cmhv7sf/relAM/HSPICE/models/models.inc, 7hv_models, mod_cmhv7sf
* CMVC Revision: 3.0
*
***********************************************************************
*
*>  Model File Include Statements
*
***********************************************************************
*
.hdl './esd_modules.va'
.hdl './esdnsh_base_va.va'
.hdl './esdnsh_base_va_dn.va'
.hdl './esdpsh_base_va.va'
.hdl './esdpsh_base_va_dn.va'
.hdl './mvcap.va'
.hdl './pcap.va'
.include './bondpad.inc'
.include './cmim.inc'
.include './cmimhd.inc'
.include './coupledwires.inc'
.include './dindpw.inc'
.include './diodednsx.inc'
.include './diodendpw.inc'
.include './diodenwx.inc'
.include './diodenx.inc'
.include './diodepnw.inc'
.include './diodepwdn.inc'
.include './dipdnw.inc'
.include './divpnp.inc'
.include './dualcmim.inc'
.include './dualcmimhd.inc'
.include './efuse.inc'
.include './esdndsx.inc'
.include './esdndidn.inc'
.include './esdnsh_base.inc'
.include './esdnsh_base_dn.inc'
.include './esdpdidn.inc'
.include './esdpsh_base.inc'
.include './esdpsh_base_dn.inc'
.include './esdvpnpnw.inc'
.include './esdfdi25.inc'
.include './esdfdi50.inc'
.include './esdtdi20.inc'
.include './esdtdi25.inc'
.include './esdtdi50.inc'
.include './hvnwres.inc'
.include './hvpwres.inc'
.include './k1res.inc'
.include './mosvarm.inc'
.include './mosvart.inc'
.include './nfet.inc'
.include './nfet_rf.inc'
.include './nfethvt.inc'
.include './nfeti.inc'
.include './nfeti4.inc'
.include './nfeti4_rf.inc'
.include './nfeti_rf.inc'
.include './nfetihvt.inc'
.include './nfetihvt4.inc'
.include './nfetim.inc'
.include './nfetim4.inc'
.include './nfetm.inc'
.include './nfetshvt.inc'
.include './nfeti20t.inc'
.include './nfeti50t.inc'
.include './nfet20mh.inc'
.include './nfeti25m.inc'
.include './nfeti50m.inc'
.include './nfeti20h.inc'
.include './nfet20hs.inc'
.include './nfeti50h.inc'
.include './nfet50hs.inc'
.include './opndires.inc'
.include './opndres.inc'
.include './opnpcres.inc'
.include './oppdires.inc'
.include './oppdres.inc'
.include './opppcres.inc'
.include './oprppres.inc'
.include './oprrpres.inc'
.include './pcapc.inc'
.include './pcapi.inc'
.include './pcapim.inc'
.include './pcdcap.inc'
.include './pfet.inc'
.include './pfet_rf.inc'
.include './pfethvt.inc'
.include './pfeti.inc'
.include './pfeti4.inc'
.include './pfeti4_rf.inc'
.include './pfeti_rf.inc'
.include './pfetihvt.inc'
.include './pfetihvt4.inc'
.include './pfetim.inc'
.include './pfetim4.inc'
.include './pfetm.inc'
.include './pfetshvt.inc'
.include './pfet20t.inc'
.include './pfet50t.inc'
.include './pfet25m.inc'
.include './pfet50m.inc'
.include './pfet20h.inc'
.include './pfet20hs.inc'
.include './pfet50h.inc'
.include './pfet50hs.inc'
.include './pjfet.inc'
.include './sbdi.inc'
.include './sblkndres.inc'
.include './sblkndires.inc'
.include './sblkpdres.inc'
.include './sblkpdires.inc'
.include './singlewire.inc'
.include './subc.inc'
.include './vncap.inc'
.include './vncap_hv.inc'
.include './vnpn.inc'
.include './vpnp.inc'
