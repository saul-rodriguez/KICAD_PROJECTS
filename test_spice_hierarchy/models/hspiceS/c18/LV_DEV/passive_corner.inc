* Path, Component, Release: cmhv7sf/rel/HSPICE/models/passive_corner.inc, 7hv_models, mod_cmrf7sf
* CMVC Revision: 2.0
*
* *********************************************************************
*
*>  Low Voltage Passive Fixed Process Corner Parameter Settings
*
*
* *********************************************************************
 
.lib rtt
.param
***********************************************************************
* "TT" corner : Nominal (default) process
***********************************************************************
+      fixcnrr     = 0
+      cor_res  = 0
.endl rtt
 
.lib rmax
.param
***********************************************************************
* "RMAX" : High resistance
***********************************************************************
+      fixcnrr     = 1
+      cor_res  = 2.5
.endl rmax
 
.lib rmin
.param
***********************************************************************
* "RMIN" : Low resistance
***********************************************************************
+      fixcnrr     = 1
+      cor_res  = -2.75
.endl rmin
 
.lib ctt
.param
***********************************************************************
* "TT" corner : Nominal (default) process
***********************************************************************
+      fixcnrc     = 0
+      cor_cap  = 0
+      cor_ind_fc  = 0
.endl ctt
 
.lib cmax
.param
***********************************************************************
* "CMAX" : High capacitance
***********************************************************************
+      fixcnrc     = 1
+      cor_cap  = 2.1
+      cor_ind_fc  = 1.1
.endl cmax
 
.lib cmin
.param
***********************************************************************
* "CMIN" : Low capacitance
***********************************************************************
+      fixcnrc     = 1
+      cor_cap  = -2.1
+      cor_ind_fc  = -1.2
.endl cmin
 
.lib dtt
.param
***********************************************************************
* "TT" corner : Nominal (default) process
***********************************************************************
+      fixcnrd     = 0
+      cor_dio_fc  = 0
.endl dtt
 
.lib dmax
.param
***********************************************************************
* "DMAX" : High diode current
***********************************************************************
+      fixcnrd     = 1
+      cor_dio_fc  = 2.9
.endl dmax
 
.lib dmin
.param
***********************************************************************
* "DMIN" : Low diode current
***********************************************************************
+      fixcnrd     = 1
+      cor_dio_fc  = -2.9
.endl dmin
