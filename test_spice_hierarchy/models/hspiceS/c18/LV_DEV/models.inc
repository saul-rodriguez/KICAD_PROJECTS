* Path, Component, Release: cmrf7sf/relAM/HSPICE/models/models.inc, rf7sf_models, mod_cmrf7sf
* CMVC Revision: 2.0
*
* CMRF7SF HSPICE Model File Include Statements
*
* Please refer to the Model Reference Guide for model usage information
* and parameter definitions.
*
.hdl './hacap.va'
.hdl './mvcap.va'
.hdl './pcap.va'
.hdl './esd_modules.va'
.hdl './esdnsh_spe.va'
.hdl './esdpsh_spe.va'
.hdl './jfetjc_xt.va'
.include './bondpad.inc'
.include './coupledwires.inc'
.include './dindpw.inc'
.include './diodenwx.inc'
.include './diodenx.inc'
.include './diodepisx.inc'
.include './diodepnw.inc'
.include './diodepwpi.inc'
.include './dipdnw.inc'
.include './divpnp.inc'
.include './dualcmim.inc'
.include './dualcmimhd.inc'
.include './efuse.inc'
.include './esdndsx.inc'
.include './esdndpi.inc'
.include './esdnsh_base.inc'
.include './esdpnpi.inc'
.include './esdpsh_base.inc'
.include './esdvpnpnw.inc'
.include './k1res.inc'
.include './cmim.inc'
.include './cmimhd.inc'
.include './mosvart.inc'
.include './mosvarm.inc'
.include './nfet.inc'
.include './nfet_psp.inc'
.include './nfethvt.inc'
.include './nfetm.inc'
.include './nfetmtw.inc'
.include './nfettw.inc'
.include './nfettw_psp.inc'
.include './opndres.inc'
.include './oppdres.inc'
.include './opppcres.inc'
.include './oprppres.inc'
.include './oprrpres.inc'
.include './pcapc.inc'
.include './pcdcap.inc'
.include './pfet.inc'
.include './pfet_psp.inc'
.include './pfethvt.inc'
.include './pfetm.inc'
.include './sblkndres.inc'
.include './sblkpdres.inc'
.include './subc.inc'
.include './vncap.inc'
